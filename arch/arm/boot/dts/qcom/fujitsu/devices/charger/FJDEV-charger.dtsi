/*
 * FJDEV-charger.dtsi
 *
 * COPYRIGHT(C) FUJITSU CONNECTED TECHNOLOGIES LIMITED 2016
 *
 * This program is free software; you can redistribute it and/or
 * modify it under the terms of the GNU General Public License
 * as published by the Free Software Foundation; version 2
 * of the License.
 *
 * This program is distributed in the hope that it will be useful,
 * but WITHOUT ANY WARRANTY; without even the implied warranty of
 * MERCHANTABILITY or FITNESS FOR A PARTICULAR PURPOSE. See the
 * GNU General Public License for more details.
 *
 * You should have received a copy of the GNU General Public License
 * along with this program; if not, write to the Free Software
 * Foundation, Inc., 59 Temple Place - Suite 330, Boston, MA 02111-1307, USA.
 */

&soc {
	fj_charge_drv {
		compatible = "fj,fj_charge_drv";
		status = "ok";

		clock-names = "chg_clk";
		clocks = <&clock_rpm clk_cxo_clk_src>;
		#clock-cells = <1>;
	};
};

&pmi8994_charger {
	qcom,battery-psy-name = "q-battery";
	qcom,dc-psy-type = "q-holder";
	/delete-property/ qcom,autoadjust-vfloat;
};
