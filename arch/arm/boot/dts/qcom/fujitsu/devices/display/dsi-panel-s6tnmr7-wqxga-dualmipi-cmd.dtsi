/*----------------------------------------------------------------------------*/
// COPYRIGHT(C) FUJITSU LIMITED 2015
// COPYRIGHT(C) Fujitsu Connected Technologies Limited 2016
/*----------------------------------------------------------------------------*/
/* Copyright (c) 2015, The Linux Foundation. All rights reserved.
 *
 * This program is free software; you can redistribute it and/or modify
 * it under the terms of the GNU General Public License version 2 and
 * only version 2 as published by the Free Software Foundation.
 *
 * This program is distributed in the hope that it will be useful,
 * but WITHOUT ANY WARRANTY; without even the implied warranty of
 * MERCHANTABILITY or FITNESS FOR A PARTICULAR PURPOSE.  See the
 * GNU General Public License for more details.
 */

/* FUJITSU LIMITED:2015-12-16 H161_5_DISP_01_0006 add start */
&mdss_mdp {
	dsi_dual_s6tnmr7_cmd_0: qcom,mdss_s6tnmr7_wqxga_dualmipi0_cmd{
		qcom,mdss-dsi-panel-name = "S6TNMR7 0 cmd mode dsi panel";
		qcom,mdss-dsi-panel-controller = <&mdss_dsi0>;
		qcom,mdss-dsi-panel-type = "dsi_cmd_mode";
		qcom,mdss-dsi-panel-destination = "display_1";
		qcom,mdss-dsi-panel-framerate = <60>;
/* FCNT LIMITED:2016-04-18 H161_5_DISP_07_0010 mod start */
		qcom,mdss-mdp-transfer-time-us = <12500>;
/* FCNT LIMITED:2016-04-18 H161_5_DISP_07_0010 mod end */
		qcom,mdss-dsi-virtual-channel-id = <0>;
		qcom,mdss-dsi-stream = <0>;
		qcom,mdss-dsi-panel-width = <1280>;
		qcom,mdss-dsi-panel-height = <1600>;
		qcom,mdss-pan-physical-width-dimension = <228>;
		qcom,mdss-pan-physical-height-dimension = <143>;
		qcom,mdss-dsi-h-front-porch = <48>;
		qcom,mdss-dsi-h-back-porch = <28>;
		qcom,mdss-dsi-h-pulse-width = <4>;
		qcom,mdss-dsi-h-sync-skew = <0>;
		qcom,mdss-dsi-v-back-porch = <15>;
		qcom,mdss-dsi-v-front-porch = <240>;
		qcom,mdss-dsi-v-pulse-width = <1>;
		qcom,mdss-dsi-h-left-border = <0>;
		qcom,mdss-dsi-h-right-border = <0>;
		qcom,mdss-dsi-v-top-border = <0>;
		qcom,mdss-dsi-v-bottom-border = <0>;
		qcom,mdss-dsi-bpp = <24>;
		qcom,mdss-dsi-color-order = "rgb_swap_rgb";
		qcom,mdss-dsi-underflow-color = <0xff>;
		qcom,mdss-dsi-border-color = <0>;
		qcom,mdss-dsi-h-sync-pulse = <0>;
		qcom,mdss-dsi-traffic-mode = "non_burst_sync_event";
		qcom,mdss-dsi-lane-map = "lane_map_0123";
		qcom,mdss-dsi-bllp-eof-power-mode;
		qcom,mdss-dsi-bllp-power-mode;
		qcom,mdss-dsi-lane-0-state;
		qcom,mdss-dsi-lane-1-state;
		qcom,mdss-dsi-lane-2-state;
		qcom,mdss-dsi-lane-3-state;
		qcom,mdss-dsi-hor-line-idle = 	<0 40 256>,
										<40 120 128>,
										<120 240 64>;
		qcom,mdss-dsi-panel-timings = [EB 38 26 00 6A 6C 2C 3C 2F 03 04 00];
		qcom,mdss-dsi-t-clk-post = <0x02>;
		qcom,mdss-dsi-t-clk-pre = <0x2C>;
		qcom,mdss-dsi-dma-trigger = "trigger_sw";
		qcom,mdss-dsi-mdp-trigger = "none";
		qcom,mdss-dsi-te-pin-select = <1>;
		qcom,mdss-dsi-wr-mem-start = <0x2c>;
		qcom,mdss-dsi-wr-mem-continue = <0x3c>;
		qcom,mdss-dsi-te-dcs-command = <1>;
		qcom,mdss-dsi-te-check-enable;
		qcom,mdss-dsi-te-using-te-pin;
		qcom,mdss-dsi-on-command = [
/* FCNT LIMITED:2016-02-05 H161_5_DISP_02_0002 mod start */
/* FCNT LIMITED:2016-06-03 H161_5_DISP_02_0002 mod start */
			15 01 00 00 00 00 02 82 1B
			39 01 00 00 00 00 03 85 77 01
/* FCNT LIMITED:2016-06-03 H161_5_DISP_02_0002 mod end */
			23 01 00 00 00 00 02 B0 34
			23 01 00 00 00 00 02 BB 1F
/* FCNT LIMITED:2016-02-05 H161_5_DISP_02_0002 mod end */
			23 01 00 00 00 00 02 B0 2E
			23 01 00 00 00 00 02 BB 01
			05 01 00 00 00 00 02 29 00
			];
		qcom,mdss-dsi-on-command-state = "dsi_hs_mode";
		qcom,mdss-dsi-off-command = [
			05 01 00 00 96 00 02 28 00
			];
		qcom,mdss-dsi-off-command-state = "dsi_hs_mode";
	};
};

&mdss_mdp {
	dsi_dual_s6tnmr7_cmd_1: qcom,mdss_s6tnmr7_wqxga_dualmipi1_cmd{
		qcom,mdss-dsi-panel-name = "S6TNMR7 1 cmd mode dsi panel";
		qcom,mdss-dsi-panel-controller = <&mdss_dsi1>;
		qcom,mdss-dsi-panel-type = "dsi_cmd_mode";
		qcom,mdss-dsi-panel-destination = "display_2";
		qcom,mdss-dsi-panel-framerate = <60>;
/* FCNT LIMITED:2016-04-18 H161_5_DISP_07_0010 mod start */
		qcom,mdss-mdp-transfer-time-us = <12500>;
/* FCNT LIMITED:2016-04-18 H161_5_DISP_07_0010 mod end */
		qcom,mdss-dsi-virtual-channel-id = <0>;
		qcom,mdss-dsi-stream = <0>;
		qcom,mdss-dsi-panel-width = <1280>;
		qcom,mdss-dsi-panel-height = <1600>;
		qcom,mdss-pan-physical-width-dimension = <228>;
		qcom,mdss-pan-physical-height-dimension = <143>;
		qcom,mdss-dsi-h-front-porch = <48>;
		qcom,mdss-dsi-h-back-porch = <28>;
		qcom,mdss-dsi-h-pulse-width = <4>;
		qcom,mdss-dsi-h-sync-skew = <0>;
		qcom,mdss-dsi-v-back-porch = <15>;
		qcom,mdss-dsi-v-front-porch = <240>;
		qcom,mdss-dsi-v-pulse-width = <1>;
		qcom,mdss-dsi-h-left-border = <0>;
		qcom,mdss-dsi-h-right-border = <0>;
		qcom,mdss-dsi-v-top-border = <0>;
		qcom,mdss-dsi-v-bottom-border = <0>;
		qcom,mdss-dsi-bpp = <24>;
		qcom,mdss-dsi-color-order = "rgb_swap_rgb";
		qcom,mdss-dsi-underflow-color = <0xff>;
		qcom,mdss-dsi-border-color = <0>;
		qcom,mdss-dsi-h-sync-pulse = <0>;
		qcom,mdss-dsi-traffic-mode = "non_burst_sync_event";
		qcom,mdss-dsi-lane-map = "lane_map_0123";
		qcom,mdss-dsi-bllp-eof-power-mode;
		qcom,mdss-dsi-bllp-power-mode;
		qcom,mdss-dsi-lane-0-state;
		qcom,mdss-dsi-lane-1-state;
		qcom,mdss-dsi-lane-2-state;
		qcom,mdss-dsi-lane-3-state;
		qcom,mdss-dsi-hor-line-idle = 	<0 40 256>,
										<40 120 128>,
										<120 240 64>;
		qcom,mdss-dsi-panel-timings = [EB 38 26 00 6A 6C 2C 3C 2F 03 04 00];
		qcom,mdss-dsi-t-clk-post = <0x02>;
		qcom,mdss-dsi-t-clk-pre = <0x2C>;
		qcom,mdss-dsi-dma-trigger = "trigger_sw";
		qcom,mdss-dsi-mdp-trigger = "none";
		qcom,mdss-dsi-te-pin-select = <1>;
		qcom,mdss-dsi-wr-mem-start = <0x2c>;
		qcom,mdss-dsi-wr-mem-continue = <0x3c>;
		qcom,mdss-dsi-te-dcs-command = <1>;
		qcom,mdss-dsi-te-check-enable;
		qcom,mdss-dsi-te-using-te-pin;
		qcom,mdss-dsi-on-command = [
/* FCNT LIMITED:2016-02-05 H161_5_DISP_02_0002 mod start */
/* FCNT LIMITED:2016-06-03 H161_5_DISP_02_0002 mod start */
			15 01 00 00 00 00 02 82 1B
			39 01 00 00 00 00 03 85 77 01
/* FCNT LIMITED:2016-06-03 H161_5_DISP_02_0002 mod end */
			23 01 00 00 00 00 02 B0 34
			23 01 00 00 00 00 02 BB 1F
/* FCNT LIMITED:2016-02-05 H161_5_DISP_02_0002 mod end */
			23 01 00 00 00 00 02 B0 2E
			23 01 00 00 00 00 02 BB 01
			05 01 00 00 00 00 02 29 00
			];
		qcom,mdss-dsi-on-command-state = "dsi_hs_mode";
		qcom,mdss-dsi-off-command = [
			05 01 00 00 96 00 02 28 00
			];
		qcom,mdss-dsi-off-command-state = "dsi_hs_mode";
	};
};
/* FUJITSU LIMITED:2015-12-16 H161_5_DISP_01_0006 add end */
