/*----------------------------------------------------------------------------*/
// COPYRIGHT(C) FUJITSU CONNECTED TECHNOLOGIES LIMITED 2016
/*----------------------------------------------------------------------------*/
/*
 * FJDEV-usb.dtsi
 *
 * Copyright(C) 2015 FUJITSU LIMITED
 *
 * This program is free software; you can redistribute it and/or
 * modify it under the terms of the GNU General Public License
 * as published by the Free Software Foundation; version 2
 * of the License.
 *
 * This program is distributed in the hope that it will be useful,
 * but WITHOUT ANY WARRANTY; without even the implied warranty of
 * MERCHANTABILITY or FITNESS FOR A PARTICULAR PURPOSE. See the
 * GNU General Public License for more details.
 *
 * You should have received a copy of the GNU General Public License
 * along with this program; if not, write to the Free Software
 * Foundation, Inc., 59 Temple Place - Suite 330, Boston, MA 02111-1307, USA.
 */

&usb3 {
	status = "ok";
	vbus_dwc3-supply = <&smbcharger_external_otg>;    /* FCNT LIMITED:2016-03-09 USB H16100533 add */
};

&hsphy0 {
	status = "ok";
	qcom,hsphy-init = <0x00D0D1A4>;    /* FCNT LIMITED:2016-03-09 USB H16100533 add */
};

&ssphy0 {
	status = "ok";
};
