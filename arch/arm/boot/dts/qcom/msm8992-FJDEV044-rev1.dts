/*
 * msm8992-FJDEV044-rev1.dts
 *
 * Copyright(C) 2015 FUJITSU LIMITED
 *
 * This program is free software; you can redistribute it and/or
 * modify it under the terms of the GNU General Public License
 * as published by the Free Software Foundation; version 2
 * of the License.
 *
 * This program is distributed in the hope that it will be useful,
 * but WITHOUT ANY WARRANTY; without even the implied warranty of
 * MERCHANTABILITY or FITNESS FOR A PARTICULAR PURPOSE. See the
 * GNU General Public License for more details.
 *
 * You should have received a copy of the GNU General Public License
 * along with this program; if not, write to the Free Software
 * Foundation, Inc., 59 Temple Place - Suite 330, Boston, MA 02111-1307, USA.
 */


/dts-v1/;

#include "msm8992.dtsi"
#include "msm8992-pinctrl.dtsi"
#include "fujitsu/targets/FJDEV044/rev1-device-list.dtsi"

/ {
	model = "Qualcomm Technologies, Inc. MSM8992 FJDEV044 Rev1";
	compatible = "qcom,msm8992-FJDEV044", "qcom,msm8992";
	qcom,board-id = <8 0>;
	qcom,msm-id = <251 0x2c000100>,<252 0x2c000100>;
};
