## drivers/audiolog/Kconfig
```kconfig
# N-FAUDIO-152047000 start
menu "Fujitsu Audio Log System Driver"

config FUJITSU_AUDIOLOG
	tristate "Fujitsu Audio Log System Driver"
	default y
endmenu
# N-FAUDIO-152047000 end
```

## drivers/haudsig/Kconfig
```kconfig
# N-FAUDIO-152015000 start
menu "Fujitsu HCE Auditory Signal support"

config FUJITSU_HAUDSIG
	tristate "Fujitsu HCE Auditory Signal Driver"
	default y
endmenu
# N-FAUDIO-152015000 end
```

## drivers/nfc/cxd224x/Kconfig
```kconfig
#
# Near Field Communication (NFC) devices
#

menuconfig NFC_DEVICES
	bool "Near Field Communication (NFC) devices"
	default n
	---help---
	  You'll have to say Y if your computer contains an NFC device that
	  you want to use under Linux.

	  You can say N here if you don't have any Near Field Communication
	  devices connected to your computer.

if NFC_DEVICES

config CXD224X_NFC
	tristate "CXD224X NFC driver"
	depends on I2C
	select CRC_CCITT
	default n
	---help---
	  Say yes if you want cxd224x Near Field Communication driver.
	  This is for i2c connected version. If unsure, say N here.

	  To compile this driver as a module, choose m here. The module will
	  be called cxd224x-i2c.

config CXD224X_NFC_VEN
	tristate "CXD224X NFC VEN"
	depends on CXD224X_NFC
	default n
	---help---
	  Say yes if you want to use cxd224x NFC VEN(enable voltage) control.
	  If unsure, say N here.

config CXD224X_NFC_RST
	tristate "CXD224X NFC RST"
	depends on CXD224X_NFC
	default y
	---help---
	  Say yes if you want to use cxd224x NFC RST(external XRST pin) control.

endif # NFC_DEVICES
```

## drivers/nonvolatile/Kconfig
```kconfig
#===============================================================================
# COPYRIGHT(C) FUJITSU LIMITED 2013 - 2014
#===============================================================================
# FUJITSU LIMITED:2014-10-23 H1510036 add start

#
# nonvolatile configuration
#
config NONVOLATILE
	tristate "Nonvolatile data read/write support"

# FUJITSU LIMITED:2014-10-23 H1510036 add end
```

## drivers/tspdrv/Kconfig
```kconfig
#===============================================================================
# COPYRIGHT(c) FUJITSU LIMITED 2016
#===============================================================================
menu "TouchSense driver support"

config TSPDRV
	tristate "TouchSense driver support"
#FUJITSU :2016-01-20 MOD-S
#	default n
	default y
#FUJITSU :2016-01-20 MOD-E

endmenu
```

## security/Kconfig
```kconfig
#
# COPYRIGHT(C) FUJITSU CONNECTED TECHNOLOGIES LIMITED 2016-2017
#
# Security configuration
#

menu "Security options"

source security/keys/Kconfig

config SECURITY_DMESG_RESTRICT
	bool "Restrict unprivileged access to the kernel syslog"
	default n
	help
	  This enforces restrictions on unprivileged users reading the kernel
	  syslog via dmesg(8).

	  If this option is not selected, no restrictions will be enforced
	  unless the dmesg_restrict sysctl is explicitly set to (1).

	  If you are unsure how to answer this question, answer N.

config SECURITY_PERF_EVENTS_RESTRICT
	bool "Restrict unprivileged use of performance events"
	depends on PERF_EVENTS
	help
	  If you say Y here, the kernel.perf_event_paranoid sysctl
	  will be set to 3 by default, and no unprivileged use of the
	  perf_event_open syscall will be permitted unless it is
	  changed.

config SECURITY
	bool "Enable different security models"
	depends on SYSFS
	help
	  This allows you to choose different security modules to be
	  configured into your kernel.

	  If this option is not selected, the default Linux security
	  model will be used.

	  If you are unsure how to answer this question, answer N.

config SECURITYFS
	bool "Enable the securityfs filesystem"
	help
	  This will build the securityfs filesystem.  It is currently used by
	  the TPM bios character driver and IMA, an integrity provider.  It is
	  not used by SELinux or SMACK.

	  If you are unsure how to answer this question, answer N.

config SECURITY_NETWORK
	bool "Socket and Networking Security Hooks"
	depends on SECURITY
	help
	  This enables the socket and networking security hooks.
	  If enabled, a security module can use these hooks to
	  implement socket and networking access controls.
	  If you are unsure how to answer this question, answer N.

config SECURITY_NETWORK_XFRM
	bool "XFRM (IPSec) Networking Security Hooks"
	depends on XFRM && SECURITY_NETWORK
	help
	  This enables the XFRM (IPSec) networking security hooks.
	  If enabled, a security module can use these hooks to
	  implement per-packet access controls based on labels
	  derived from IPSec policy.  Non-IPSec communications are
	  designated as unlabelled, and only sockets authorized
	  to communicate unlabelled data can send without using
	  IPSec.
	  If you are unsure how to answer this question, answer N.

config SECURITY_PATH
	bool "Security hooks for pathname based access control"
	depends on SECURITY
	help
	  This enables the security hooks for pathname based access control.
	  If enabled, a security module can use these hooks to
	  implement pathname based access controls.
	  If you are unsure how to answer this question, answer N.

config FIDO_SEC
	bool "config LSM for FIDO"
        depends on SECURITY
        default n
        help
	  If you are unsure how to answer this question, answer N.

config SECURITY_PFT
	bool "Security hooks for Per File Encryption"
	depends on SECURITY
	depends on PFT
	help
	  This enables the security hooks for Per File Encryption.
	  If enabled, a security module can use these hooks to
	  implement file based access controls and encryption.
	  If you are unsure how to answer this question, answer N.

config INTEL_TXT
	bool "Enable Intel(R) Trusted Execution Technology (Intel(R) TXT)"
	depends on HAVE_INTEL_TXT
	help
	  This option enables support for booting the kernel with the
	  Trusted Boot (tboot) module. This will utilize
	  Intel(R) Trusted Execution Technology to perform a measured launch
	  of the kernel. If the system does not support Intel(R) TXT, this
	  will have no effect.

	  Intel TXT will provide higher assurance of system configuration and
	  initial state as well as data reset protection.  This is used to
	  create a robust initial kernel measurement and verification, which
	  helps to ensure that kernel security mechanisms are functioning
	  correctly. This level of protection requires a root of trust outside
	  of the kernel itself.

	  Intel TXT also helps solve real end user concerns about having
	  confidence that their hardware is running the VMM or kernel that
	  it was configured with, especially since they may be responsible for
	  providing such assurances to VMs and services running on it.

	  See <http://www.intel.com/technology/security/> for more information
	  about Intel(R) TXT.
	  See <http://tboot.sourceforge.net> for more information about tboot.
	  See Documentation/intel_txt.txt for a description of how to enable
	  Intel TXT support in a kernel boot.

	  If you are unsure as to whether this is required, answer N.

config LSM_MMAP_MIN_ADDR
	int "Low address space for LSM to protect from user allocation"
	depends on SECURITY && SECURITY_SELINUX
	default 32768 if ARM
	default 65536
	help
	  This is the portion of low virtual memory which should be protected
	  from userspace allocation.  Keeping a user from writing to low pages
	  can help reduce the impact of kernel NULL pointer bugs.

	  For most ia64, ppc64 and x86 users with lots of address space
	  a value of 65536 is reasonable and should cause no problems.
	  On arm and other archs it should not be higher than 32768.
	  Programs which use vm86 functionality or have some need to map
	  this low address space will need the permission specific to the
	  systems running LSM.

# FCNT LIMITED:2015-10-26 SEC-KERNEL_HARDENING-001 add start
config SECURITY_PTMX
    bool "fix /dev/ptmx fops"
    depends on SECURITY
    default y
# FCNT LIMITED:2015-10-26 SEC-KERNEL_HARDENING-001 add end

source security/selinux/Kconfig
source security/smack/Kconfig
source security/tomoyo/Kconfig
source security/apparmor/Kconfig
source security/yama/Kconfig

source security/integrity/Kconfig

# FUJITSU:2014-12-08 GEN-141-SCRU-ALT ADD S
config SECURITY_FJSEC
	bool "FJSEC LSM Support"
	depends on SECURITY
	help
	  This is a FJSEC LSM module.

	  If you are unsure how to answer this question, answer N.

config SECURITY_FJSEC_AC_SECURE_STORAGE
	bool "Enable access control to secure storage."
	depends on SECURITY_FJSEC
	default y

config SECURITY_FJSEC_AC_KITTING
	bool "Enable access control to Kitting directory and partition."
	depends on SECURITY_FJSEC
	default y

config SECURITY_FJSEC_DISK_DEV_PATH
	string "block device path for main disk"
	depends on SECURITY_FJSEC
	default "/dev/block/mmcblk0"

config SECURITY_FJSEC_SYSTEM_DIR_PATH
	string "system directory PATH"
	depends on SECURITY_FJSEC
	default "/system/"

config SECURITY_FJSEC_SECURE_STORAGE_DIR_PATH
	string "secure storage PATH"
	depends on SECURITY_FJSEC_AC_SECURE_STORAGE
	default "/sst/"

config SECURITY_FJSEC_KITTING_DIR_PATH
	string "kitting directory PATH"
	depends on SECURITY_FJSEC_AC_KITTING
	default "/kitting/"

config SECURITY_FJSEC_SYSTEM_DEV_PATH
	string "block device path for /system/"
	depends on SECURITY_FJSEC
	default "/dev/block/mmcblk0p39"

config SECURITY_FJSEC_SECURE_STORAGE_DEV_PATH
	string "block device path for /sst/"
	depends on SECURITY_FJSEC_AC_SECURE_STORAGE
	default "/dev/block/mmcblk0p48"

config SECURITY_FJSEC_KITTING_DEV_PATH
	string "block device path for /kitting/"
	depends on SECURITY_FJSEC_AC_KITTING
	default "/dev/block/mmcblk0p54"

# FCNT LIMITED:2016-03-14 mod -S
config SECURITY_FJSEC_DM_DEV_PATH
	string "block device path for device-mapper feature"
	depends on SECURITY_FJSEC
	default "/dev/block/dm-"
# FCNT LIMITED:2016-03-14 mod -E

config SECURITY_FJSEC_FELICA_DEV_PATH
	string "device path for FeliCa"
	depends on SECURITY_FJSEC
	default "/dev/felica"

config SECURITY_FJSEC_FELICA_DEV2_PATH
	string "device path for FeliCa"
	depends on SECURITY_FJSEC
	default "/dev/felica"

config SECURITY_FJSEC_NFC_DEV_PATH
	string "device path for NFC"
	depends on SECURITY_FJSEC
	default "/dev/snfc_uart"

config SECURITY_FJSEC_PROTECT_CHROOT
	bool "Enable fjsec_path_chroot()"
	depends on SECURITY_FJSEC && SECURITY_PATH
	default y

config SECURITY_FJSEC_CHROOT_PATH
	string "chroot() allow PATH"
	depends on SECURITY_FJSEC && SECURITY_PATH && SECURITY_FJSEC_PROTECT_CHROOT
	default ""
	help
	  This is a list of paths to allow chroot()
	  For example "/chroot/:/security/"

config SECURITY_FJSEC_SECURE_STORAGE_ACCESS_PROCESS_NAME
	string "Accessible process name to /sst/"
	depends on SECURITY_FJSEC_AC_SECURE_STORAGE
	default "qseecomd"

config SECURITY_FJSEC_SECURE_STORAGE_ACCESS_PROCESS_PATH
	string "Accessible process path to /sst/"
	depends on SECURITY_FJSEC_AC_SECURE_STORAGE
	default "/system/bin/qseecomd"

config SECURITY_FJSEC_FOTA_MODE_ACCESS_PROCESS_NAME
	string "Accessible process name to /system/, /sst/ in FOTA mode"
	depends on SECURITY_FJSEC
	default "recovery"

config SECURITY_FJSEC_FOTA_MODE_ACCESS_PROCESS_PATH
	string "Accessible process path to /system/, /sst/ in FOTA mode"
	depends on SECURITY_FJSEC
	default "/sbin/recovery"

config SECURITY_FJSEC_SDDOWNLOADER_MODE_ACCESS_PROCESS_NAME
	string "Accessible process name to /system/, /sst/ in SD Downloader mode"
	depends on SECURITY_FJSEC
	default "recovery"

config SECURITY_FJSEC_SDDOWNLOADER_MODE_ACCESS_PROCESS_PATH
	string "Accessible process path to /system/, /sst/ in SD Downloader mode"
	depends on SECURITY_FJSEC
	default "/sbin/recovery"

config SECURITY_FJSEC_RECOVERY_MODE_ACCESS_PROCESS_NAME
	string "Accessible process name to /sst/ in recovery mode"
	depends on SECURITY_FJSEC
	default "recovery"

config SECURITY_FJSEC_RECOVERY_MODE_ACCESS_PROCESS_PATH
	string "Accessible process path to /sst/ in recovery mode"
	depends on SECURITY_FJSEC
	default "/sbin/recovery"

config SECURITY_FJSEC_MAKERCMD_MODE_ACCESS_PROCESS_NAME
	string "Accessible process name to /sst/ in maker mode"
	depends on SECURITY_FJSEC
	default "makercmd"

config SECURITY_FJSEC_MAKERCMD_MODE_ACCESS_PROCESS_PATH
	string "Accessible process path to /sst/ in maker mode"
	depends on SECURITY_FJSEC
	default "/system/bin/makercmd"

config SECURITY_FJSEC_OSUPDATE_MODE_ACCESS_PROCESS_NAME
	string "Accessible process name to mmcdl device in OS update mode"
	depends on SECURITY_FJSEC
	default "recovery"

config SECURITY_FJSEC_OSUPDATE_MODE_ACCESS_PROCESS_PATH
	string "Accessible process path to mmcdl device in OS update mode"
	depends on SECURITY_FJSEC
	default "/sbin/recovery"

config SECURITY_MMAP_DISABLE
	bool "disable fjsec_check_mapping()"
	depends on SECURITY_FJSEC

config LSM_ON
	bool "Enable fjsec LSM"
	depends on SECURITY_FJSEC
	default y

# FUJITSU:2014-12-08 GEN-141-SCRU-ALT ADD E

choice
	prompt "Default security module"
	default DEFAULT_SECURITY_SELINUX if SECURITY_SELINUX
	default DEFAULT_SECURITY_SMACK if SECURITY_SMACK
	default DEFAULT_SECURITY_TOMOYO if SECURITY_TOMOYO
	default DEFAULT_SECURITY_APPARMOR if SECURITY_APPARMOR
	default DEFAULT_SECURITY_YAMA if SECURITY_YAMA
	default DEFAULT_SECURITY_PFT if SECURITY_PFT
	default DEFAULT_SECURITY_DAC

	help
	  Select the security module that will be used by default if the
	  kernel parameter security= is not specified.

	config DEFAULT_SECURITY_SELINUX
		bool "SELinux" if SECURITY_SELINUX=y

	config DEFAULT_SECURITY_SMACK
		bool "Simplified Mandatory Access Control" if SECURITY_SMACK=y

	config DEFAULT_SECURITY_TOMOYO
		bool "TOMOYO" if SECURITY_TOMOYO=y

	config DEFAULT_SECURITY_APPARMOR
		bool "AppArmor" if SECURITY_APPARMOR=y

	config DEFAULT_SECURITY_YAMA
		bool "Yama" if SECURITY_YAMA=y

	config DEFAULT_SECURITY_PFT
		bool "PFT" if SECURITY_PFT=y

	config DEFAULT_SECURITY_DAC
		bool "Unix Discretionary Access Controls"

endchoice

config DEFAULT_SECURITY
	string
	default "selinux" if DEFAULT_SECURITY_SELINUX
	default "smack" if DEFAULT_SECURITY_SMACK
	default "tomoyo" if DEFAULT_SECURITY_TOMOYO
	default "apparmor" if DEFAULT_SECURITY_APPARMOR
	default "yama" if DEFAULT_SECURITY_YAMA
	default "pft" if DEFAULT_SECURITY_PFT
	default "" if DEFAULT_SECURITY_DAC

# FUJITSU:2014-12-08 GEN-141-SCRU-ALT ADD S
config DETECT_RH
	bool "Detect RH"
	depends on SECURITY_FJSEC
	default y
	help
	  If enabled, we will detect RH and then set RH flag.
	  If you are unsure how to answer this question, answer N.
# FUJITSU:2014-12-08 GEN-141-SCRU-ALT ADD E

endmenu
```
